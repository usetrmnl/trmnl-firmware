## sdkconfig.defaults.TRMNL_X_EPDIY
```kconfig
#########################################################################
# Per-variant overrides for env:TRMNL_X_EPDIY (delta vs TRMNL_X).
# AUTO-EXTRACTED. Edit deliberately; rebuild any affected env to
# regenerate the materialized sdkconfig.<env>.
#########################################################################

CONFIG_SOC_CPU_WATCHPOINT_MAX_REGION_SIZE=64
CONFIG_SOC_GPIO_SUPPORT_HOLD_IO_IN_DSLP=y
CONFIG_SOC_RMT_SUPPORT_TX_ASYNC_STOP=y
CONFIG_SOC_SDM_GROUPS=y
CONFIG_SOC_MEMSPI_SRC_FREQ_120M=y
CONFIG_SOC_SPI_MEM_SUPPORT_OPI_MODE=y
CONFIG_ESPTOOLPY_FLASHFREQ_80M_DEFAULT=y
CONFIG_USE_AFE=y
# CONFIG_USE_NSNET is not set
CONFIG_USE_WAKENET=y
# CONFIG_SR_WN_WN8_ALEXA is not set
# CONFIG_SR_WN_WN9_HIXIAOXING_TTS is not set
# CONFIG_SR_WN_WN9_CUSTOMWORD is not set
# CONFIG_SR_WN_LOAD_MULIT_WORD is not set
CONFIG_USE_MULTINET=y
CONFIG_BT_ALARM_MAX_NUM=50
CONFIG_I2C_ENABLE_DEBUG_LOG=y
# CONFIG_ESP_WIFI_TESTING_OPTIONS is not set
CONFIG_HAL_SPI_MASTER_FUNC_IN_IRAM=y
CONFIG_HAL_SPI_SLAVE_FUNC_IN_IRAM=y
# CONFIG_HAL_ECDSA_GEN_SIG_CM is not set
# CONFIG_LWIP_NETIF_API is not set
# CONFIG_LWIP_PPP_SUPPORT is not set
CONFIG_SPI_FLASH_SUSPEND_QVL_SUPPORTED=y
CONFIG_SPI_FLASH_VENDOR_XMC_SUPPORTED=y
CONFIG_SPI_FLASH_VENDOR_GD_SUPPORTED=y
CONFIG_SPI_FLASH_VENDOR_ISSI_SUPPORTED=y
CONFIG_SPI_FLASH_VENDOR_MXIC_SUPPORTED=y
CONFIG_SPI_FLASH_VENDOR_WINBOND_SUPPORTED=y
CONFIG_SPI_FLASH_VENDOR_BOYA_SUPPORTED=y
CONFIG_SPI_FLASH_VENDOR_TH_SUPPORTED=y
# CONFIG_MCPWM_ISR_IN_IRAM is not set
# CONFIG_WPA_TESTING_OPTIONS is not set
# CONFIG_PPP_SUPPORT is not set
```
