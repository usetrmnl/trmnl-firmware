## sdkconfig.defaults.TRMNL_X_SENSORIAC5
```kconfig
#########################################################################
# Per-variant overrides for env:TRMNL_X_SENSORIAC5 (delta vs TRMNL_X).
# AUTO-EXTRACTED. Edit deliberately; rebuild any affected env to
# regenerate the materialized sdkconfig.<env>.
#########################################################################

CONFIG_SOC_ANA_CMPR_SUPPORTED=y
CONFIG_SOC_ETM_SUPPORTED=y
CONFIG_SOC_PARLIO_SUPPORTED=y
CONFIG_SOC_LP_CORE_SUPPORTED=y
CONFIG_SOC_RSA_SUPPORTED=y
CONFIG_SOC_ECC_SUPPORTED=y
CONFIG_SOC_ECC_EXTENDED_MODES_SUPPORTED=y
CONFIG_SOC_IEEE802154_SUPPORTED=y
CONFIG_SOC_APM_SUPPORTED=y
CONFIG_SOC_PMU_SUPPORTED=y
CONFIG_SOC_PMU_PVT_SUPPORTED=y
CONFIG_SOC_PAU_SUPPORTED=y
CONFIG_SOC_LP_TIMER_SUPPORTED=y
CONFIG_SOC_LP_AON_SUPPORTED=y
CONFIG_SOC_LP_PERIPHERALS_SUPPORTED=y
CONFIG_SOC_LP_I2C_SUPPORTED=y
CONFIG_SOC_ULP_LP_UART_SUPPORTED=y
CONFIG_SOC_ASSIST_DEBUG_SUPPORTED=y
CONFIG_SOC_SDIO_SLAVE_SUPPORTED=y
CONFIG_SOC_ECDSA_SUPPORTED=y
CONFIG_SOC_KEY_MANAGER_SUPPORTED=y
CONFIG_SOC_HUK_SUPPORTED=y
CONFIG_SOC_MODEM_CLOCK_SUPPORTED=y
CONFIG_SOC_CLOCK_TREE_MANAGEMENT_SUPPORTED=y
CONFIG_SOC_BITSCRAMBLER_SUPPORTED=y
CONFIG_SOC_XTAL_SUPPORT_48M=y
CONFIG_SOC_XTAL_CLOCK_PATH_DEPENDS_ON_TOP_DOMAIN=y
CONFIG_SOC_AES_SUPPORT_PSEUDO_ROUND_FUNCTION=y
CONFIG_SOC_ADC_PERIPH_NUM=1
CONFIG_SOC_ADC_MAX_CHANNEL_NUM=6
CONFIG_SOC_ADC_DIGI_CONTROLLER_NUM=1
CONFIG_SOC_ADC_PATT_LEN_MAX=8
CONFIG_SOC_ADC_CALIB_CHAN_COMPENS_SUPPORTED=y
CONFIG_SOC_ADC_TEMPERATURE_SHARE_INTR=y
CONFIG_SOC_SHARED_IDCACHE_SUPPORTED=y
CONFIG_SOC_CPU_CORES_NUM=1
CONFIG_SOC_CPU_HAS_FLEXIBLE_INTC=y
CONFIG_SOC_CPU_SUPPORT_WFE=y
CONFIG_SOC_INT_CLIC_SUPPORTED=y
CONFIG_SOC_INT_HW_NESTED_SUPPORTED=y
CONFIG_SOC_BRANCH_PREDICTOR_SUPPORTED=y
CONFIG_SOC_CPU_BREAKPOINTS_NUM=3
CONFIG_SOC_CPU_WATCHPOINTS_NUM=3
CONFIG_SOC_CPU_WATCHPOINT_MAX_REGION_SIZE=0x100
CONFIG_SOC_CPU_HAS_PMA=y
CONFIG_SOC_CPU_IDRAM_SPLIT_USING_PMP=y
CONFIG_SOC_CPU_PMP_REGION_GRANULARITY=128
CONFIG_SOC_CPU_HAS_LOCKUP_RESET=y
CONFIG_SOC_DS_SIGNATURE_MAX_BIT_LEN=3072
CONFIG_SOC_DMA_CAN_ACCESS_FLASH=y
CONFIG_SOC_AHB_GDMA_VERSION=2
CONFIG_SOC_GDMA_PAIRS_PER_GROUP_MAX=3
CONFIG_SOC_GDMA_SUPPORT_ETM=y
CONFIG_SOC_GDMA_SUPPORT_SLEEP_RETENTION=y
CONFIG_SOC_GDMA_EXT_MEM_ENC_ALIGNMENT=16
CONFIG_SOC_ETM_GROUPS=1
CONFIG_SOC_ETM_CHANNELS_PER_GROUP=50
CONFIG_SOC_ETM_SUPPORT_SLEEP_RETENTION=y
CONFIG_SOC_GPIO_PIN_COUNT=29
CONFIG_SOC_GPIO_FLEX_GLITCH_FILTER_NUM=8
CONFIG_SOC_GPIO_SUPPORT_PIN_HYS_FILTER=y
CONFIG_SOC_GPIO_SUPPORT_ETM=y
CONFIG_SOC_GPIO_SUPPORT_DEEPSLEEP_WAKEUP=y
CONFIG_SOC_GPIO_IN_RANGE_MAX=28
CONFIG_SOC_GPIO_OUT_RANGE_MAX=28
CONFIG_SOC_GPIO_DEEP_SLEEP_WAKE_VALID_GPIO_MASK=0
CONFIG_SOC_GPIO_DEEP_SLEEP_WAKE_SUPPORTED_PIN_CNT=7
CONFIG_SOC_GPIO_VALID_DIGITAL_IO_PAD_MASK=0x0000000001FFFF80
CONFIG_SOC_GPIO_SUPPORT_HOLD_SINGLE_IO_IN_DSLP=y
CONFIG_SOC_GPIO_CLOCKOUT_BY_GPIO_MATRIX=y
CONFIG_SOC_CLOCKOUT_HAS_SOURCE_GATE=y
CONFIG_SOC_RTCIO_PIN_COUNT=7
CONFIG_SOC_RTCIO_EDGE_WAKE_SUPPORTED=y
CONFIG_SOC_DEDIC_PERIPH_ALWAYS_ENABLE=y
CONFIG_SOC_ANA_CMPR_NUM=1
CONFIG_SOC_ANA_CMPR_CAN_DISTINGUISH_EDGE=y
CONFIG_SOC_ANA_CMPR_SUPPORT_ETM=y
CONFIG_SOC_HP_I2C_NUM=1
CONFIG_SOC_I2C_SUPPORT_HW_FSM_RST=y
CONFIG_SOC_I2C_SLAVE_SUPPORT_SLAVE_UNMATCH=y
CONFIG_SOC_I2C_SUPPORT_SLEEP_RETENTION=y
CONFIG_SOC_LP_I2C_NUM=1
CONFIG_SOC_LP_I2C_FIFO_LEN=16
CONFIG_SOC_I2S_NUM=1
CONFIG_SOC_I2S_SUPPORTS_ETM=y
CONFIG_SOC_I2S_SUPPORTS_PLL_F240M=y
CONFIG_SOC_I2S_SUPPORTS_TX_SYNC_CNT=y
CONFIG_SOC_I2S_PDM_MAX_RX_LINES=1
CONFIG_SOC_I2S_TDM_FULL_DATA_WIDTH=y
CONFIG_SOC_I2S_SUPPORT_SLEEP_RETENTION=y
CONFIG_SOC_LEDC_SUPPORT_PLL_DIV_CLOCK=y
CONFIG_SOC_LEDC_CHANNEL_NUM=6
CONFIG_SOC_LEDC_TIMER_BIT_WIDTH=20
CONFIG_SOC_LEDC_GAMMA_CURVE_FADE_SUPPORTED=y
CONFIG_SOC_LEDC_GAMMA_CURVE_FADE_RANGE_MAX=16
CONFIG_SOC_LEDC_FADE_PARAMS_BIT_WIDTH=10
CONFIG_SOC_LEDC_SUPPORT_SLEEP_RETENTION=y
CONFIG_SOC_MMU_DI_VADDR_SHARED=y
CONFIG_SOC_PCNT_SUPPORT_RUNTIME_THRES_UPDATE=y
CONFIG_SOC_PCNT_SUPPORT_CLEAR_SIGNAL=y
CONFIG_SOC_PCNT_SUPPORT_STEP_NOTIFY=y
CONFIG_SOC_PCNT_SUPPORT_SLEEP_RETENTION=y
CONFIG_SOC_RMT_TX_CANDIDATES_PER_GROUP=2
CONFIG_SOC_RMT_RX_CANDIDATES_PER_GROUP=2
CONFIG_SOC_RMT_CHANNELS_PER_GROUP=4
CONFIG_SOC_RMT_SUPPORT_SLEEP_RETENTION=y
CONFIG_SOC_MCPWM_GROUPS=1
CONFIG_SOC_MCPWM_EVENT_COMPARATORS_PER_OPERATOR=2
CONFIG_SOC_MCPWM_SUPPORT_ETM=y
CONFIG_SOC_MCPWM_SUPPORT_EVENT_COMPARATOR=y
CONFIG_SOC_MCPWM_CAPTURE_CLK_FROM_GROUP=y
CONFIG_SOC_MCPWM_SUPPORT_SLEEP_RETENTION=y
CONFIG_SOC_PARLIO_GROUPS=1
CONFIG_SOC_PARLIO_TX_UNITS_PER_GROUP=1
CONFIG_SOC_PARLIO_RX_UNITS_PER_GROUP=1
CONFIG_SOC_PARLIO_TX_UNIT_MAX_DATA_WIDTH=8
CONFIG_SOC_PARLIO_RX_UNIT_MAX_DATA_WIDTH=8
CONFIG_SOC_PARLIO_TX_CLK_SUPPORT_GATING=y
CONFIG_SOC_PARLIO_RX_CLK_SUPPORT_GATING=y
CONFIG_SOC_PARLIO_RX_CLK_SUPPORT_OUTPUT=y
CONFIG_SOC_PARLIO_TRANS_BIT_ALIGN=y
CONFIG_SOC_PARLIO_TX_SUPPORT_LOOP_TRANSMISSION=y
CONFIG_SOC_PARLIO_TX_SUPPORT_EOF_FROM_DMA=y
CONFIG_SOC_PARLIO_SUPPORT_SLEEP_RETENTION=y
CONFIG_SOC_PARLIO_SUPPORT_SPI_LCD=y
CONFIG_SOC_PARLIO_SUPPORT_I80_LCD=y
CONFIG_SOC_RSA_MAX_BIT_LEN=3072
CONFIG_SOC_ECC_CONSTANT_TIME_POINT_MUL=y
CONFIG_SOC_ECC_SUPPORT_CURVE_P384=y
CONFIG_SOC_ECDSA_SUPPORT_EXPORT_PUBKEY=y
CONFIG_SOC_ECDSA_SUPPORT_DETERMINISTIC_MODE=y
CONFIG_SOC_ECDSA_SUPPORT_HW_DETERMINISTIC_LOOP=y
CONFIG_SOC_ECDSA_SUPPORT_CURVE_P384=y
CONFIG_SOC_ECDSA_SUPPORT_CURVE_SPECIFIC_KEY_PURPOSES=y
CONFIG_SOC_SDM_CHANNELS_PER_GROUP=4
CONFIG_SOC_SDM_CLK_SUPPORT_PLL_F80M=y
CONFIG_SOC_SDM_CLK_SUPPORT_XTAL=y
CONFIG_SOC_SPI_PERIPH_NUM=2
CONFIG_SOC_SPI_SUPPORT_SLEEP_RETENTION=y
CONFIG_SOC_SPI_SUPPORT_CLK_PLL_F160M=y
CONFIG_SOC_SPI_SUPPORT_CLK_RC_FAST=y
CONFIG_SOC_SPI_MEM_SUPPORT_IDLE_INTR=y
CONFIG_SOC_SPI_MEM_SUPPORT_CHECK_SUS=y
CONFIG_SOC_SPI_MEM_SUPPORT_WB_MODE_INDEPENDENT_CONTROL=y
CONFIG_SOC_SPI_MEM_SUPPORT_TSUS_TRES_SEPERATE_CTR=y
CONFIG_SOC_SPI_MEM_PSRAM_FREQ_AXI_CONSTRAINED=y
CONFIG_SOC_SYSTIMER_SUPPORT_RC_FAST=y
CONFIG_SOC_SYSTIMER_SUPPORT_ETM=y
CONFIG_SOC_TIMER_GROUP_TIMERS_PER_GROUP=1
CONFIG_SOC_TIMER_GROUP_SUPPORT_RC_FAST=y
CONFIG_SOC_TIMER_GROUP_TOTAL_TIMERS=2
CONFIG_SOC_TIMER_SUPPORT_ETM=y
CONFIG_SOC_TIMER_SUPPORT_SLEEP_RETENTION=y
CONFIG_SOC_MWDT_SUPPORT_SLEEP_RETENTION=y
CONFIG_SOC_TWAI_CONTROLLER_NUM=2
CONFIG_SOC_TWAI_MASK_FILTER_NUM=3
CONFIG_SOC_TWAI_RANGE_FILTER_NUM=1
CONFIG_SOC_TWAI_BRP_MIN=1
CONFIG_SOC_TWAI_BRP_MAX=255
CONFIG_SOC_TWAI_CLK_SUPPORT_XTAL=y
CONFIG_SOC_TWAI_SUPPORT_FD=y
CONFIG_SOC_TWAI_SUPPORT_TIMESTAMP=y
CONFIG_SOC_EFUSE_DIS_PAD_JTAG=y
CONFIG_SOC_EFUSE_ECDSA_KEY=y
CONFIG_SOC_EFUSE_ECDSA_KEY_P192=y
CONFIG_SOC_EFUSE_ECDSA_KEY_P384=y
CONFIG_SOC_HUK_MEM_NEEDS_RECHARGE=y
CONFIG_SOC_KEY_MANAGER_SUPPORT_KEY_DEPLOYMENT=y
CONFIG_SOC_KEY_MANAGER_ECDSA_KEY_DEPLOY=y
CONFIG_SOC_KEY_MANAGER_FE_KEY_DEPLOY=y
CONFIG_SOC_KEY_MANAGER_FE_KEY_DEPLOY_XTS_AES_128=y
CONFIG_SOC_KEY_MANAGER_FE_KEY_DEPLOY_XTS_AES_256=y
CONFIG_SOC_KEY_MANAGER_HMAC_KEY_DEPLOY=y
CONFIG_SOC_KEY_MANAGER_DS_KEY_DEPLOY=y
CONFIG_SOC_SECURE_BOOT_V2_ECC=y
CONFIG_SOC_FLASH_ENCRYPTION_XTS_AES_SUPPORT_PSEUDO_ROUND=y
CONFIG_SOC_PSRAM_ENCRYPTION_XTS_AES_128=y
CONFIG_SOC_RECOVERY_BOOTLOADER_SUPPORTED=y
CONFIG_SOC_BOOTLOADER_ANTI_ROLLBACK_SUPPORTED=y
CONFIG_SOC_APM_CTRL_FILTER_SUPPORTED=y
CONFIG_SOC_APM_LP_APM0_SUPPORTED=y
CONFIG_SOC_APM_CPU_APM_SUPPORTED=y
CONFIG_SOC_APM_SUPPORT_LP_TEE_CTRL=y
CONFIG_SOC_APM_SUPPORT_CTRL_CFG_LOCK=y
CONFIG_SOC_APM_SUPPORT_TEE_PERI_ACCESS_CTRL=y
CONFIG_SOC_CRYPTO_DPA_PROTECTION_SUPPORTED=y
CONFIG_SOC_RNG_BUF_CHAIN_ENTROPY_SOURCE=y
CONFIG_SOC_RNG_RTC_TIMER_ENTROPY_SOURCE=y
CONFIG_SOC_UART_HP_NUM=2
CONFIG_SOC_UART_LP_NUM=1
CONFIG_SOC_LP_UART_FIFO_LEN=16
CONFIG_SOC_UART_SUPPORT_PLL_F80M_CLK=y
CONFIG_SOC_UART_HAS_LP_UART=y
CONFIG_SOC_UART_SUPPORT_SLEEP_RETENTION=y
CONFIG_SOC_UART_WAKEUP_CHARS_SEQ_MAX_LEN=5
CONFIG_SOC_UART_WAKEUP_SUPPORT_FIFO_THRESH_MODE=y
CONFIG_SOC_UART_WAKEUP_SUPPORT_START_BIT_MODE=y
CONFIG_SOC_UART_WAKEUP_SUPPORT_CHAR_SEQ_MODE=y
CONFIG_SOC_EXTERNAL_COEX_ADVANCE=y
CONFIG_SOC_RTC_MEM_SUPPORT_SPEED_MODE_SWITCH=y
CONFIG_SOC_PM_SUPPORT_BEACON_WAKEUP=y
CONFIG_SOC_PM_SUPPORT_EXT1_WAKEUP_MODE_PER_PIN=y
CONFIG_SOC_PM_SUPPORT_XTAL32K_PD=y
CONFIG_SOC_PM_SUPPORT_RC32K_PD=y
CONFIG_SOC_PM_SUPPORT_TOP_PD=y
CONFIG_SOC_PM_SUPPORT_HP_AON_PD=y
CONFIG_SOC_PM_SUPPORT_PMU_MODEM_STATE=y
CONFIG_SOC_PM_SUPPORT_PMU_CLK_ICG=y
CONFIG_SOC_PM_CPU_RETENTION_BY_SW=y
CONFIG_SOC_PM_MODEM_RETENTION_BY_REGDMA=y
CONFIG_SOC_EXT_MEM_CACHE_TAG_IN_CPU_DOMAIN=y
CONFIG_SOC_PM_PAU_LINK_NUM=5
CONFIG_SOC_PM_PAU_REGDMA_LINK_CONFIGURABLE=y
CONFIG_SOC_PM_PAU_REGDMA_LINK_IDX_WIFIMAC=4
CONFIG_SOC_PM_PAU_REGDMA_COMMON_PHY_LINK_ENTRY=y
CONFIG_SOC_PM_PMU_MIN_SLP_SLOW_CLK_CYCLE_FIXED=y
CONFIG_SOC_PM_RETENTION_MODULE_NUM=32
CONFIG_SOC_MODEM_CLOCK_IS_INDEPENDENT=y
CONFIG_SOC_RNG_CLOCK_IS_INDEPENDENT=y
CONFIG_SOC_CLK_OSC_SLOW_SUPPORTED=y
CONFIG_SOC_CLK_LP_FAST_SUPPORT_XTAL=y
CONFIG_SOC_RCC_IS_INDEPENDENT=y
CONFIG_SOC_CLK_ANA_I2C_MST_HAS_ROOT_GATE=y
CONFIG_SOC_TEMPERATURE_SENSOR_SUPPORT_XTAL=y
CONFIG_SOC_TEMPERATURE_SENSOR_INTR_SUPPORT=y
CONFIG_SOC_TEMPERATURE_SENSOR_SUPPORT_SLEEP_RETENTION=y
CONFIG_SOC_TEMPERATURE_SENSOR_UNDER_PD_TOP_DOMAIN=y
CONFIG_SOC_WIFI_HE_SUPPORT=y
CONFIG_SOC_WIFI_SUPPORT_5G=y
CONFIG_SOC_WIFI_MAC_VERSION_NUM=3
CONFIG_SOC_WIFI_NAN_SUPPORT=y
CONFIG_SOC_ESP_NIMBLE_CONTROLLER=y
CONFIG_SOC_BLE_POWER_CONTROL_SUPPORTED=y
CONFIG_SOC_BLE_MULTI_CONN_OPTIMIZATION=y
CONFIG_SOC_BLE_PERIODIC_ADV_ENH_SUPPORTED=y
CONFIG_SOC_BLE_CTE_SUPPORTED=y
CONFIG_SOC_BLE_PERIODIC_ADV_WITH_RESPONSE=y
CONFIG_SOC_PHY_CALIBRATION_CLOCK_IS_INDEPENDENT=y
CONFIG_SOC_LP_CORE_SINGLE_INTERRUPT_VECTOR=y
CONFIG_SOC_LP_CORE_SUPPORT_ETM=y
CONFIG_SOC_LP_CORE_SUPPORT_STORE_LOAD_EXCEPTIONS=y
CONFIG_IDF_ENV_BRINGUP=y
CONFIG_IDF_TARGET_ARCH_RISCV=y
CONFIG_IDF_TARGET_ARCH="riscv"
CONFIG_IDF_TARGET="esp32c5"
CONFIG_IDF_INIT_VERSION="5.5.2"
CONFIG_IDF_TARGET_ESP32C5=y
CONFIG_IDF_FIRMWARE_CHIP_ID=0x0017
# CONFIG_BOOTLOADER_RECOVERY_ENABLE is not set
CONFIG_BOOTLOADER_OFFSET_IN_FLASH=0x2000
CONFIG_BOOTLOADER_COMPILER_OPTIMIZATION_SIZE=y
# CONFIG_BOOTLOADER_COMPILER_OPTIMIZATION_PERF is not set
# CONFIG_BOOTLOADER_LOG_LEVEL_NONE is not set
CONFIG_BOOTLOADER_LOG_LEVEL_INFO=y
CONFIG_BOOTLOADER_LOG_LEVEL=3
# CONFIG_BOOTLOADER_SKIP_VALIDATE_IN_DEEP_SLEEP is not set
CONFIG_BOOTLOADER_RESERVE_RTC_SIZE=0
CONFIG_SECURE_BOOT_V2_ECC_SUPPORTED=y
CONFIG_ESP_ROM_USB_SERIAL_DEVICE_NUM=3
CONFIG_ESP_ROM_HAS_RVFPLIB=y
CONFIG_ESP_ROM_HAS_HAL_SYSTIMER=y
CONFIG_ESP_ROM_SYSTIMER_INIT_PATCH=y
CONFIG_ESP_ROM_HAS_HEAP_TLSF=y
CONFIG_ESP_ROM_TLSF_CHECK_PATCH=y
CONFIG_ESP_ROM_MULTI_HEAP_WALK_PATCH=y
CONFIG_ESP_ROM_WITHOUT_REGI2C=y
CONFIG_ESP_ROM_WDT_INIT_PATCH=y
CONFIG_ESP_ROM_USB_OTG_NUM=-1
CONFIG_ESP_ROM_CLIC_INT_THRESH_PATCH=y
CONFIG_ESP_ROM_HAS_SUBOPTIMAL_NEWLIB_ON_MISALIGNED_MEMORY=y
CONFIG_ESP_ROM_DELAY_US_PATCH=y
CONFIG_ESP_ROM_SUPPORT_SECURE_BOOT_FAST_WAKEUP=y
# CONFIG_SECURE_ENABLE_TEE is not set
CONFIG_SECURE_TEE_LOG_LEVEL=0
CONFIG_ESPTOOLPY_NO_STUB=y
# CONFIG_ESPTOOLPY_FLASHMODE_QIO is not set
CONFIG_ESPTOOLPY_FLASHMODE_DIO=y
CONFIG_ESPTOOLPY_FLASHSIZE_4MB=y
# CONFIG_ESPTOOLPY_FLASHSIZE_16MB is not set
CONFIG_ESPTOOLPY_FLASHSIZE="4MB"
# CONFIG_PARTITION_TABLE_SINGLE_APP is not set
CONFIG_PARTITION_TABLE_SINGLE_APP_LARGE=y
CONFIG_PARTITION_TABLE_FILENAME="partitions_singleapp_large.csv"
CONFIG_ARDUINO_VARIANT="esp32c5"
CONFIG_ARDUINO_RUN_CORE0=y
CONFIG_ARDUINO_RUNNING_CORE=0
CONFIG_ARDUINO_EVENT_RUN_CORE0=y
CONFIG_ARDUINO_EVENT_RUNNING_CORE=0
CONFIG_ARDUINO_SERIAL_EVENT_RUN_CORE0=y
CONFIG_ARDUINO_SERIAL_EVENT_TASK_RUNNING_CORE=0
# CONFIG_ARDUHAL_LOG_DEFAULT_LEVEL_NONE is not set
CONFIG_ARDUHAL_LOG_DEFAULT_LEVEL_ERROR=y
CONFIG_ARDUHAL_LOG_DEFAULT_LEVEL=1
# CONFIG_ARDUHAL_PARTITION_SCHEME_DEFAULT is not set
CONFIG_ARDUHAL_PARTITION_SCHEME_MIN_SPIFFS=y
CONFIG_ARDUHAL_PARTITION_SCHEME="min_spiffs"
CONFIG_COMPILER_OPTIMIZATION_DEBUG=y
# CONFIG_COMPILER_OPTIMIZATION_PERF is not set
# CONFIG_COMPILER_FLOAT_LIB_FROM_GCCLIB is not set
CONFIG_COMPILER_FLOAT_LIB_FROM_RVFPLIB=y
# CONFIG_COMPILER_SAVE_RESTORE_LIBCALLS is not set
CONFIG_ESP_COEX_SW_COEXIST_ENABLE=y
# CONFIG_ESP_COEX_POWER_MANAGEMENT is not set
CONFIG_ANA_CMPR_ISR_HANDLER_IN_IRAM=y
# CONFIG_ANA_CMPR_CTRL_FUNC_IN_IRAM is not set
# CONFIG_ANA_CMPR_ISR_CACHE_SAFE is not set
CONFIG_ANA_CMPR_OBJ_CACHE_SAFE=y
# CONFIG_ANA_CMPR_ENABLE_DEBUG_LOG is not set
# CONFIG_BITSCRAMBLER_CTRL_FUNC_IN_IRAM is not set
CONFIG_PARLIO_TX_ISR_HANDLER_IN_IRAM=y
CONFIG_PARLIO_RX_ISR_HANDLER_IN_IRAM=y
# CONFIG_PARLIO_TX_ISR_CACHE_SAFE is not set
# CONFIG_PARLIO_RX_ISR_CACHE_SAFE is not set
CONFIG_PARLIO_OBJ_CACHE_SAFE=y
# CONFIG_PARLIO_ENABLE_DEBUG_LOG is not set
# CONFIG_PARLIO_ISR_IRAM_SAFE is not set
# CONFIG_TEMP_SENSOR_ISR_IRAM_SAFE is not set
CONFIG_ESP32C5_REV_MIN_100=y
# CONFIG_ESP32C5_REV_MIN_102 is not set
CONFIG_ESP32C5_REV_MIN_FULL=100
CONFIG_ESP_REV_MIN_FULL=100
CONFIG_ESP32C5_REV_MAX_FULL=199
CONFIG_ESP_REV_MAX_FULL=199
CONFIG_ESP_EFUSE_BLOCK_REV_MAX_FULL=99
CONFIG_ESP_MAC_ADDR_UNIVERSE_IEEE802154=y
# CONFIG_ESP32C5_UNIVERSAL_MAC_ADDRESSES_TWO is not set
CONFIG_ESP32C5_UNIVERSAL_MAC_ADDRESSES_FOUR=y
CONFIG_ESP32C5_UNIVERSAL_MAC_ADDRESSES=4
# CONFIG_ESP_SLEEP_MSPI_NEED_ALL_IO_PU is not set
CONFIG_ESP_SLEEP_WAIT_FLASH_READY_EXTRA_DELAY=0
CONFIG_RTC_FAST_CLK_SRC_RC_FAST=y
# CONFIG_RTC_FAST_CLK_SRC_XTAL is not set
# CONFIG_ETM_ENABLE_DEBUG_LOG is not set
CONFIG_XTAL_FREQ_AUTO=y
CONFIG_XTAL_FREQ=0
CONFIG_ESP_CLK_RC32K_NOT_TO_USE=y
CONFIG_ESP_ENABLE_PVT=y
CONFIG_PM_SLEEP_FUNC_IN_IRAM=y
CONFIG_PM_SLP_DEFAULT_PARAMS_OPT=y
# CONFIG_PM_POWER_DOWN_PERIPHERAL_IN_LIGHT_SLEEP is not set
CONFIG_PM_WORKAROUND_FREQ_LIMIT_ENABLED=y
CONFIG_SPIRAM_MODE_QUAD=y
# CONFIG_SPIRAM_SPEED_80M is not set
CONFIG_SPIRAM_SPEED_40M=y
CONFIG_SPIRAM_SPEED=40
CONFIG_ESP_CRYPTO_DPA_PROTECTION_AT_STARTUP=y
CONFIG_ESP_CRYPTO_DPA_PROTECTION_LEVEL_LOW=y
# CONFIG_ESP_CRYPTO_DPA_PROTECTION_LEVEL_MEDIUM is not set
# CONFIG_ESP_CRYPTO_DPA_PROTECTION_LEVEL_HIGH is not set
CONFIG_ESP_CRYPTO_DPA_PROTECTION_LEVEL=1
# CONFIG_ESP_CRYPTO_FORCE_ECC_CONSTANT_TIME_POINT_MUL is not set
CONFIG_CACHE_L1_CACHE_SIZE=0x8000
CONFIG_CACHE_L1_CACHE_LINE_SIZE=32
CONFIG_ESP_SYSTEM_SINGLE_CORE_MODE=y
CONFIG_ESP_SYSTEM_NO_BACKTRACE=y
# CONFIG_ESP_SYSTEM_USE_EH_FRAME is not set
# CONFIG_ESP_SYSTEM_USE_FRAME_POINTER is not set
CONFIG_ESP_SYSTEM_PMP_IDRAM_SPLIT=y
# CONFIG_ESP_SYSTEM_PMP_LP_CORE_RESERVE_MEM_EXECUTABLE is not set
CONFIG_ESP_SYSTEM_HW_STACK_GUARD=y
CONFIG_ESP_SYSTEM_HW_PC_RECORD=y
CONFIG_ESP_IPC_TASK_STACK_SIZE=1024
# CONFIG_ESP_WIFI_NVS_ENABLED is not set
CONFIG_ESP_WIFI_EXTRA_IRAM_OPT=y
CONFIG_ESP_WIFI_SLP_IRAM_OPT=y
CONFIG_ESP_WIFI_BSS_MAX_IDLE_SUPPORT=y
# CONFIG_ESP_WIFI_NAN_ENABLE is not set
# CONFIG_ESP_WIFI_EAP_TLS1_3 is not set
CONFIG_ESP_WIFI_11KV_SUPPORT=y
CONFIG_ESP_WIFI_RRM_SUPPORT=y
CONFIG_ESP_WIFI_WNM_SUPPORT=y
CONFIG_ESP_WIFI_SCAN_CACHE=y
CONFIG_ESP_WIFI_MBO_SUPPORT=y
CONFIG_ESP_WIFI_ENABLE_ROAMING_APP=y
CONFIG_ESP_WIFI_ROAMING_LOW_RSSI_ROAMING=y
CONFIG_ESP_WIFI_ROAMING_LOW_RSSI_THRESHOLD=-60
CONFIG_ESP_WIFI_ROAMING_LOW_RSSI_OFFSET=5
CONFIG_ESP_WIFI_ROAMING_PERIODIC_SCAN_MONITOR=y
CONFIG_ESP_WIFI_ROAMING_PERIODIC_SCAN_THRESHOLD=-50
CONFIG_ESP_WIFI_ROAMING_SCAN_MONITOR_INTERVAL=30
CONFIG_ESP_WIFI_ROAMING_SCAN_ROAM_RSSI_DIFF=15
CONFIG_ESP_WIFI_ROAMING_LEGACY_ROAMING=y
CONFIG_ESP_WIFI_ROAMING_NETWORK_ASSISTED_ROAM=y
CONFIG_ESP_WIFI_NETWORK_ASSISTED_ROAMING_RETRY_COUNT=2
# CONFIG_ESP_WIFI_NETWORK_ASSISTED_ROAMING_IP_RENEW_SKIP is not set
CONFIG_ESP_WIFI_ROAMING_SCAN_MIN_SCAN_TIME=30
CONFIG_ESP_WIFI_ROAMING_SCAN_MAX_SCAN_TIME=70
CONFIG_ESP_WIFI_ROAMING_HOME_CHANNEL_DWELL_TIME=30
CONFIG_ESP_WIFI_ROAMING_SCAN_CHAN_LIST="None"
CONFIG_ESP_WIFI_ROAMING_SCAN_EXPIRY_WINDOW=10
CONFIG_ESP_WIFI_ROAMING_BACKOFF_TIME=15
# CONFIG_ESP_WIFI_ROAMING_PERIODIC_RRM_MONITORING is not set
# CONFIG_ESP_WIFI_ROAMING_BSSID_BLACKLIST is not set
CONFIG_ESP_WIFI_ROAMING_MAX_CANDIDATES=5
# CONFIG_ESP_WIFI_ROAMING_PREVENT_DOWNGRADE is not set
CONFIG_ESP_WIFI_11R_SUPPORT=y
# CONFIG_ESP_WIFI_ENABLE_WIFI_TX_STATS is not set
# CONFIG_ESP_WIFI_ENABLE_WIFI_RX_STATS is not set
CONFIG_ESP_WIFI_TX_HETB_QUEUE_NUM=3
# CONFIG_ESP_WIFI_ENABLE_DUMP_HESIGB is not set
# CONFIG_ESP_WIFI_ENABLE_DUMP_MU_CFO is not set
# CONFIG_ESP_WIFI_ENABLE_DUMP_CTRL_NDPA is not set
# CONFIG_ESP_WIFI_ENABLE_DUMP_CTRL_BFRP is not set
CONFIG_FREERTOS_UNICORE=y
CONFIG_FREERTOS_OPTIMIZED_SCHEDULER=y
CONFIG_FREERTOS_TASK_FUNCTION_WRAPPER=y
CONFIG_FREERTOS_NUMBER_OF_CORES=1
CONFIG_HAL_SYSTIMER_USE_ROM_IMPL=y
CONFIG_HEAP_TLSF_USE_ROM_IMPL=y
CONFIG_IEEE802154_ENABLED=y
CONFIG_IEEE802154_RX_BUFFER_SIZE=20
# CONFIG_IEEE802154_CCA_CARRIER is not set
CONFIG_IEEE802154_CCA_ED=y
# CONFIG_IEEE802154_CCA_CARRIER_OR_ED is not set
# CONFIG_IEEE802154_CCA_CARRIER_AND_ED is not set
CONFIG_IEEE802154_CCA_MODE=1
CONFIG_IEEE802154_CCA_THRESHOLD=-75
CONFIG_IEEE802154_PENDING_TABLE_SIZE=20
# CONFIG_IEEE802154_MULTI_PAN_ENABLE is not set
CONFIG_IEEE802154_INTERFACE_NUM=1
CONFIG_IEEE802154_TIMING_OPTIMIZATION=y
# CONFIG_IEEE802154_DEBUG is not set
# CONFIG_IEEE802154_DEBUG_ASSERT_MONITOR is not set
# CONFIG_LOG_DEFAULT_LEVEL_NONE is not set
CONFIG_LOG_DEFAULT_LEVEL_INFO=y
CONFIG_LOG_DEFAULT_LEVEL=3
CONFIG_LOG_MAXIMUM_LEVEL=3
# CONFIG_MBEDTLS_AES_USE_PSEUDO_ROUND_FUNC is not set
CONFIG_MBEDTLS_LARGE_KEY_SOFTWARE_MPI=y
CONFIG_MBEDTLS_HARDWARE_ECC=y
CONFIG_MBEDTLS_ECC_OTHER_CURVES_SOFT_FALLBACK=y
# CONFIG_MBEDTLS_HARDWARE_ECDSA_SIGN is not set
CONFIG_MBEDTLS_HARDWARE_ECDSA_VERIFY=y
# CONFIG_LIBC_PICOLIBC is not set
# CONFIG_LIBC_OPTIMIZED_MISALIGNED_ACCESS is not set
CONFIG_SPI_FLASH_SUSPEND_TRS_VAL_US=50
# CONFIG_SPI_FLASH_SUPPORT_ISSI_CHIP is not set
# CONFIG_SPI_FLASH_SUPPORT_MXIC_CHIP is not set
# CONFIG_SPI_FLASH_SUPPORT_WINBOND_CHIP is not set
# CONFIG_SPI_FLASH_SUPPORT_TH_CHIP is not set
CONFIG_SPI_FLASH_FREQ_LIMIT_C5_240MHZ=y
CONFIG_DSP_ANSI=y
CONFIG_DSP_OPTIMIZATION=0
CONFIG_FMB_PORT_TASK_AFFINITY=0x7FFFFFFF
CONFIG_IDF_EXPERIMENTAL_FEATURES=y
# CONFIG_LOG_BOOTLOADER_LEVEL_NONE is not set
CONFIG_LOG_BOOTLOADER_LEVEL_INFO=y
CONFIG_LOG_BOOTLOADER_LEVEL=3
# CONFIG_FLASHMODE_QIO is not set
CONFIG_FLASHMODE_DIO=y
CONFIG_OPTIMIZATION_LEVEL_DEBUG=y
CONFIG_COMPILER_OPTIMIZATION_LEVEL_DEBUG=y
CONFIG_COMPILER_OPTIMIZATION_DEFAULT=y
CONFIG_SW_COEXIST_ENABLE=y
CONFIG_ESP32_WIFI_SW_COEXIST_ENABLE=y
CONFIG_ESP_WIFI_SW_COEXIST_ENABLE=y
# CONFIG_ANA_CMPR_ISR_IRAM_SAFE is not set
CONFIG_IPC_TASK_STACK_SIZE=1024
# CONFIG_ESP32_WIFI_NVS_ENABLED is not set
CONFIG_WPA_11KV_SUPPORT=y
CONFIG_WPA_SCAN_CACHE=y
CONFIG_WPA_MBO_SUPPORT=y
CONFIG_WPA_11R_SUPPORT=y
```
